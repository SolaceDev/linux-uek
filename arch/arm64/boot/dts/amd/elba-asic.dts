// SPDX-License-Identifier: (GPL-2.0-only OR BSD-2-Clause)
/*
 * Device Tree file for AMD Pensando Elba Board.
 *
 * Copyright 2020-2022 Advanced Micro Devices, Inc.
 */

/dts-v1/;

#include "elba.dtsi"
#include "elba-16core.dtsi"
#include "elba-16core-spin-table.dtsi"
#include "elba-asic-common.dtsi"
#include "elba-flash-parts.dtsi"
#include "elba-asic-memory.dtsi"
#include "elba-mdev.dtsi"

/ {
	model = "AMD Pensando Elba Board";
	compatible = "amd,pensando-elba";

	aliases {
		serial0 = &uart0;
		spi0 = &spi0;
		spi1 = &qspi;
	};

	chosen {
		stdout-path = "serial0:115200n8";
	};
};
